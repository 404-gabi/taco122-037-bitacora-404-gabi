int ledPin = 9;  // pin PWM :v
int potPin = A0;
int valorPot = 0;
int potMapeado = 0;

// "grises" de un led dou
int intensidadLed = 0;

void setup() {
  pinMode(ledPin, OUTPUT);
  Serial.begin(9600);
}

void loop() {
  valorPot = analogRead(potPin);

  // mapear de 0-1023 a 0-255
  potMapeado = map(valorPot, 0, 1023, 0, 255);
  intensidadLed = potMapeado;

// encargo 
  if (valorPot < 205) {
    intensidadLed = 820;
  } else if (valorPot < 410) {
    intensidadLed = 255;
  } else if (valorPot < 615) {
    intensidadLed = 128;
  } else if (valorPot < 0) {
    intensidadLed = 192;
  } else {
    intensidadLed = 9;
  }

  analogWrite(ledPin, intensidadLed);
  Serial.println(intensidadLed);
}


//⬜⬜⬜⬛⬛⬛⬛⬜⬜⬜⬜⬜⬜⬜⬜⬜⬜⬜⬜⬜⬜⬜
//⬜⬜⬛⬛⬛⬜⬜⬛⬜⬜⬜⬜⬜⬜⬜⬜⬜⬜⬜⬜⬜⬜
//⬜⬛⬛⬜⬜⬛⬛⬛⬛⬛⬛⬜⬜⬜⬜⬜⬜⬜⬜⬜⬜⬜
//⬛⬜⬛⬛⬛🟨🟨🟨🟨🟨🟨⬛⬛⬜⬜⬜⬜⬜⬜⬜⬜⬜
//⬛⬜⬛🟨🟨🟨🟨🟨🟨🟨🟨🟨🟨⬛⬜⬜⬜⬜⬜⬜⬜⬜
//⬜⬛🟨⬛🟨🟨🟨🟨🟨🟨🟨🟨🟨🟨⬛⬜⬜⬜⬜⬜⬜⬜
//⬜⬛🟨🟨🟨🟨🟨🟨🟨🟨🟨🟨🟨🟨⬛⬜⬜⬜⬜⬜⬜⬜
//⬛🟨🟨🟨🟨🟨🟨🟨🟨🟨🟨🟨🟨🟨🟨⬛⬜⬜⬜⬜⬜⬜
//⬛🟨🟨🟨🟨🟨🟨🟨🟨🟨🟨🟨🟨🟨🟨⬛⬛⬛⬜⬜⬜⬜
//⬛🟨🟨🟨🟨🟨🟨🟨🟨🟨⬛⬛⬛⬛⬛⬜⬜⬜⬛⬜⬜⬜
//⬛🟨🟨🟨🟨🟨🟨🟨🟨⬛⬜⬜⬜⬜⬛⬜⬜⬜⬜⬛⬜⬜
//⬛🟨🟨🟨🟨🟨🟨🟨⬛⬜⬜⬜⬜⬜⬜⬛⬜⬛⬜⬛⬜⬜
//⬛🟨🟨🟨🟨🟨🟨🟨⬛⬜⬜⬜⬜⬜⬜⬛⬜⬜⬜⬛⬜⬜
//⬜⬛🟨🟨⬛🟨🟨🟨⬛⬜⬜⬛⬜⬜⬜⬛⬛⬛⬛⬜⬜⬜
//⬜⬛🟨🟨⬛⬛🟨🟨🟨⬛⬜⬜⬜⬜⬛🟨🟨🟨🟨⬛⬜⬜
//⬜⬛⬛⬛🟨🟨⬛🟨🟨🟨⬛⬛⬛⬛🟨🟨🟨🟨🟨⬛⬜⬜
//⬜⬛⬜⬛⬛🟨🟨🟨🟨🟨🟨🟨🟨🟨🟨⬛⬛⬛⬛⬜⬜⬜
//⬜⬜⬜⬛⬛⬛🟨🟨🟨🟨🟨🟨⬛⬛⬛🟧🟧🟧🟧⬛⬜⬜
//⬜⬜⬜⬛🟨🟨🟨🟨🟨🟨🟨⬛🟧🟧🟧🟧🟧🟧🟧🟧⬛⬜
//⬜⬜⬜⬛🟨🟨⬛🟨🟨🟨⬛🟧🟧🟧🟧🟧🟧🟧🟧🟧⬛⬜
//⬜⬜⬜⬜⬛⬛🟨🟨🟨⬛🟧🟧🟧🟧🟧🟧🟧🟧🟧🟧🟧⬛
//⬜⬜⬜⬜⬜⬛🟨🟨🟨⬛🟧⬛🟧🟧🟧🟧🟧🟧🟧🟧🟧⬛
//⬜⬜⬜⬜⬜⬛🟨🟨🟨⬛🟧⬛⬛⬛⬛⬛⬛⬛⬛⬛⬛⬜
//⬜⬜⬜⬜⬜⬛🟨🟨🟨⬛🟧🟧🟧🟧🟧🟧🟧⬛⬜⬜⬜⬜
//⬜⬜⬜⬜⬜⬛🟨🟨🟨🟨⬛🟧🟧🟧🟧🟧⬛⬜⬜⬜⬜⬜
//⬜⬜⬜⬜⬜⬛🟨🟨🟨🟨⬛🟧🟧🟧🟧🟧⬛⬜⬜⬜⬜⬜
//⬜⬜⬜⬜⬛⬛🟨🟨🟨🟨🟨⬛🟧🟧🟧⬛⬜⬜⬜⬜⬜⬜
//⬜⬜⬜⬛⬜⬜⬛⬛🟨🟨🟨🟨⬛⬛⬛⬛⬛⬜⬜⬜⬜⬜
//⬜⬜⬜⬛⬜⬜⬜⬜⬛⬛🟨🟨🟨🟨🟨⬛🟦⬛⬜⬜⬜⬜
//⬜⬜⬛⬛⬜⬜⬜⬜⬜⬜⬛⬛🟨🟨🟨⬛🟦🟦⬛⬛⬜⬜
//⬜⬛🟦🟦⬛⬜⬜⬜⬜⬜⬜⬛⬛🟨🟨⬛🟦🟦🟦⬛⬜⬜
//⬜⬛⬛⬛⬛⬛⬛⬛⬛⬛⬛⬛⬛⬛⬛⬛⬛⬛⬛⬛⬛⬜

